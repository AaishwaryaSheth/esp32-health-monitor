## sdkconfig.defaults
```kconfig
# --- ESP32 Health Monitor: build defaults ---

# FreeRTOS: run-time stats needed for CPU load %
CONFIG_FREERTOS_USE_TRACE_FACILITY=y
CONFIG_FREERTOS_GENERATE_RUN_TIME_STATS=y
CONFIG_FREERTOS_VTASKLIST_INCLUDE_COREID=y

# Use 1000 Hz tick for finer CPU-load resolution
CONFIG_FREERTOS_HZ=1000

# MQTT over TLS (HiveMQ Cloud uses port 8883 + server cert)
CONFIG_MQTT_PROTOCOL_311=y

# Embed the HiveMQ Cloud root CA (see main/CMakeLists embedding below)
# TLS / mbedTLS large enough for cloud broker handshakes
CONFIG_MBEDTLS_DYNAMIC_BUFFER=y

# Slightly larger main task stack for TLS + JSON build
CONFIG_ESP_MAIN_TASK_STACK_SIZE=4096

# Log level
CONFIG_LOG_DEFAULT_LEVEL_INFO=y
```
